## Kconfig.ztacx
```kconfig
mainmenu "Ztacx"
	
config ZTACX_NAME_BASE
       string "Device name base (will have device ID appended)"
       default "ztacx"

config ZTACX_VALUE_NAME_MAX
       int "Maximum length of the name of a setting or state variable"
       default 40
       

config ZTACX_LEAF_I2C
       bool
       default n
       select I2C
       
config ZTACX_LEAF_I2C0
       bool "Enable Ztacx leaf for I2C bus 0"
       default n
       select ZTACX_LEAF_I2C
config ZTACX_LEAF_I2C1
       bool "Enable Ztacx leaf for I2C bus 1"
       default n
       select ZTACX_LEAF_I2C

config ZTACX_LEAF_BATTERY
       bool "Enable Ztacx leaf for battery level monitoring"
       default n
       select ADC

config ZTACX_BATTERY_READ_INTERVAL
       int "Duration between battery level reads in seconds"
       default 60
       depends on ZTACX_LEAF_BATTERY

config ZTACX_BATTERY_DIVIDER_LOW
       int "Value of the low-side resistor in the battery voltage divider"
       default 220 
       depends on ZTACX_LEAF_BATTERY

config ZTACX_BATTERY_DIVIDER_HIGH
       int "Value of the high-side resistor in the battery voltage divider"
       default 100
       depends on ZTACX_LEAF_BATTERY

config ZTACX_BATTERY_CHANGE_THRESHOLD
       int "Threshold (in millivolts) for reporting of battery level changes"
       default 50
       depends on ZTACX_LEAF_BATTERY

config ZTACX_LEAF_BT_PERIPHERAL
       bool "Enable Ztacx leaf for Bluetooth Peripheral mode"
       default n

config ZTACX_LEAF_BT_UART
       bool "Enable Ztacx leaf for Bluetooth LE UART"
       default n

config ZTACX_LEAF_GPS
       bool "Enable Ztacx leaf for serial GPS"
       default n

config ZTACX_LEAF_KP
       bool "Enable Ztacx leaf for i2c keypad"
       default n
       select I2C

config ZTACX_LEAF_LED
       bool "Enable Ztacx leaf for the default status LED"
       default n
       select GPIO

config ZTACX_KP_BUS
       string "I2C bus for keypad"
       default I2C_1
       depends on ZTACX_LEAF_KP 

config ZTACX_KP_ADDR
       int "I2C address for keypad"
       default 32
       depends on ZTACX_LEAF_KP

config ZTACX_KP_INTERVAL
       int "Keypad scan interval milliseconds"
       default 100
       depends on ZTACX_LEAF_KP

config ZTACX_LED_CYCLE
       int "Defalt LED blink rate in milliseconds"
       default 1000
       depends on ZTACX_LEAF_LED 

config ZTACX_LED_DUTY
       int "Defalt LED duty cycle in percent"
       default 50
       depends on ZTACX_LEAF_LED

config ZTACX_LEAF_LIDAR
       bool "Enable Ztacx leaf for LIDAR sensor(s)"
       default n

config ZTACX_LEAF_LUX
       bool "Enable Ztacx leaf for light level sensor(s)"
       default n

config ZTACX_LEAF_IMS
       bool "Enable Ztacx leaf for inerial measurement sensor"
       default n

config ZTACX_IMS_DEVICE
       string "Name of device to use for IMS readings"
       default "IMS"
       depends on ZTACX_LEAF_IMS

config ZTACX_IMS_READ_INTERVAL_USEC
       int "Time between samples in microseconds"
       default 1000
       depends on ZTACX_LEAF_IMS

config ZTACX_IMS_CHANGE_THRESHOLD
       int "Significant change threshold (in cm/s/s)"
       default 10
       depends on ZTACX_LEAF_IMS

config ZTACX_LEAF_BUTTON
       bool "Enable Ztacx leaf for input button(s)"
       default n
       select GPIO

config ZTACX_BUTTON_MAX
       int "Maximum number of ztacx button inputs"
       default 4
       depends on ZTACX_LEAF_BUTTON

config ZTACX_LEAF_POWER
       bool "Enable Ztacx leaf for power mode control"
       default n
       select PM
       select PM_DEVICE

config ZTACX_LEAF_PWMLED
       bool "Enable Ztacx leaf for PWM LED"
       default n

config ZTACX_LEAF_SETTINGS
       bool "Enable Ztacx leaf for peristent settings"
       default n
       select SETTINGS
       
config ZTACX_LEAF_LORAWAN
       bool "Enable Ztacx leaf for LoRaWAN"
       default n
       select ZTACX_LEAF_SETTINGS

config ZTACX_LEAF_LORA_MODEM
       bool "Enable Ztacx leaf for eByte LoRaWAN MODEM"
       default n
       select MODEM_RECEIVER
       select MODEM_SHELL
       select MODEM_CMD_HANDLER

config ZTACX_LORA_MODEM_UART
       string "Name of LoRa MODEM UART device"
       default "UART-1"
       depends on ZTACX_LEAF_LORA_MODEM

config ZTACX_LEAF_SPKR
       bool "Enable Ztacx leaf for simple speaker"
       default n

config ZTACX_LEAF_TEMP
       bool "Enable Ztacx leaf for temperature monitoring"
       default n

config ZTACX_TEMP_DEVICE
       string "Name of sensor to use for temperature readings"
       default ""
       depends on ZTACX_LEAF_TEMP

config ZTACX_TEMP_I2C_GENERIC
       bool "Enable generic I2C temperature sensor"
       default n
       depends on ZTACX_LEAF_TEMP

config ZTACX_TEMP_I2C_GENERIC_BUS
       string "I2C bus for generic I2C temperature sensor"
       default "I2C_0"
       depends on ZTACX_TEMP_I2C_GENERIC

config ZTACX_TEMP_I2C_GENERIC_ADDR
       int "Address for generic I2C temperature sensor"
       default 74
       depends on ZTACX_TEMP_I2C_GENERIC

config ZTACX_TEMP_I2C_GENERIC_REGISTER
       int "Register index for generic I2C temperature sensor"
       default 7
       depends on ZTACX_TEMP_I2C_GENERIC
```

## samples/bt_sensor/Kconfig
```kconfig
mainmenu "Example"

config APP_SHOCK_INTERVAL_SEC
       int "Interval at which to update the shock alarm (seconds)"
       default 5

config APP_SHOCK_THRESHOLD
       int "Threshold for shock alert (cm/s/s)"
       default 2000

rsource "../../Kconfig.ztacx"
source "Kconfig.zephyr"
```

## samples/bt_thermometer/Kconfig
```kconfig
mainmenu "Example"

config APP_USE_AMBIENT
       bool "Default to ambient temperature not object"
       default n

rsource "../../Kconfig.ztacx"
source "Kconfig.zephyr"
```

## samples/dac/boards/accelerando_hailstone.conf
```kconfig
# USB console
#CONFIG_USB_DEVICE_STACK=y
#CONFIG_USB_DEVICE_PRODUCT="Hailstone"
#CONFIG_USB_DEVICE_VID=1209
#CONFIG_USB_DEVICE_PID=ACC1
#CONFIG_USB_CDC_ACM_LOG_LEVEL_OFF=y
CONFIG_SERIAL=y
CONFIG_CONSOLE=y
CONFIG_UART_CONSOLE=y
#CONFIG_UART_LINE_CTRL=y
CONFIG_SHELL_BACKEND_SERIAL=y
CONFIG_LOG_BACKEND_UART=y


#RTT console
#CONFIG_USE_SEGGER_RTT=y
#CONFIG_RTT_CONSOLE=y
#CONFIG_UART_CONSOLE=n
#CONFIG_SEGGER_RTT_BUFFER_SIZE_DOWN=64
#CONFIG_SHELL_BACKEND_RTT=y
```

## samples/shell/boards/accelerando_hailstone.conf
```kconfig
CONFIG_SETTINGS_FILE=y
CONFIG_SETTINGS_FILE_PATH="/lfs1/settings/run"
#CONFIG_DHT=y
#CONFIG_GPIO_PCF8574=y

CONFIG_BASE64=y
CONFIG_BOOTLOADER_MCUBOOT=y
CONFIG_MCUBOOT_SIGNATURE_KEY_FILE="bootloader/mcuboot/root-rsa-2048.pem"
CONFIG_MCUBOOT_SHELL=y
CONFIG_BT=y
CONFIG_BT_PERIPHERAL=y
CONFIG_BT_ATT_PREPARE_COUNT=5
#CONFIG_BT_BAS=y
CONFIG_BT_L2CAP_TX_MTU=600
CONFIG_BT_BUF_ACL_RX_SIZE=600
CONFIG_BT_BUF_ACL_TX_SIZE=600
CONFIG_BT_SHELL=y
CONFIG_HWINFO=y
CONFIG_HWINFO_SHELL=y
CONFIG_NET_BUF=y
CONFIG_ZCBOR=y
CONFIG_CRC=y
CONFIG_MCUMGR=y
CONFIG_STREAM_FLASH=y
CONFIG_FLASH_MAP=y
CONFIG_MCUMGR_TRANSPORT_BT=y
CONFIG_MCUMGR_TRANSPORT_SHELL=y
CONFIG_MCUMGR_GRP_OS_TASKSTAT=y
CONFIG_STATS=y
CONFIG_STATS_NAMES=y
CONFIG_IMG_MANAGER=y
CONFIG_MCUMGR_GRP_IMG=y
CONFIG_MCUMGR_GRP_OS=y
CONFIG_MCUMGR_GRP_STAT=y
#CONFIG_MCUMGR_SMP_BT_AUTHEN=n
CONFIG_UART_CONSOLE_MCUMGR=y

CONFIG_MCUMGR_TRANSPORT_BT=y
CONFIG_MCUMGR_TRANSPORT_BT_AUTHEN=n
CONFIG_MCUMGR_TRANSPORT_BT_CONN_PARAM_CONTROL=y
CONFIG_MCUMGR_TRANSPORT_BT_REASSEMBLY=y
CONFIG_MCUMGR_TRANSPORT_NETBUF_SIZE=2475
CONFIG_MCUMGR_GRP_OS_MCUMGR_PARAMS=y
CONFIG_MCUMGR_TRANSPORT_WORKQUEUE_STACK_SIZE=4608
CONFIG_MCUMGR_GRP_ZBASIC=y
CONFIG_MCUMGR_GRP_ZBASIC_STORAGE_ERASE=y


# USB console
CONFIG_USB_DEVICE_STACK=y
CONFIG_USB_DEVICE_PRODUCT="Hailstone"
CONFIG_USB_DEVICE_VID=1209
CONFIG_USB_DEVICE_PID=ACC1
CONFIG_USB_CDC_ACM_LOG_LEVEL_OFF=y
CONFIG_SERIAL=y
CONFIG_CONSOLE=y
CONFIG_UART_CONSOLE=y
CONFIG_UART_LINE_CTRL=y
CONFIG_SHELL_BACKEND_SERIAL=y
CONFIG_LOG_BACKEND_UART=y

#RTT console
#CONFIG_USE_SEGGER_RTT=y
#CONFIG_RTT_CONSOLE=y
#CONFIG_UART_CONSOLE=n
#CONFIG_SEGGER_RTT_BUFFER_SIZE_DOWN=64
#CONFIG_SHELL_BACKEND_RTT=y
```
