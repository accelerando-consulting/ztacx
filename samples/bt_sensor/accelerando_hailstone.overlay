&i2c1 {
	status = "okay";

        lis2dh12: lis2dh12@18 {
                compatible = "st,lis2dh12", "st,lis2dh";
                reg = <0x18>;
                //irq-gpios = <&gpio0 3 GPIO_ACTIVE_HIGH>;
                label = "IMS";
        };

/*
        adxl345@53 {
                compatible = "adi,adxl345";
                reg = <0x53>;
                label = "IMS";
        };
*/
};

&spi1 {
	status = "disabled";
};
